## config/west.yml
```yaml
manifest:
  remotes:
    - name: zmkfirmware
      url-base: https://github.com/zmkfirmware
    - name: petejohanson
      url-base: https://github.com/petejohanson
    - name: narze
      url-base: https://github.com/narze
  projects:
    - name: zmk
      remote: zmkfirmware
      revision: main
      import: app/west.yml

    # Splitkb + encoder fix from Stephen's fork
    # Ref: https://github.com/zmkfirmware/zmk/pull/728
    # - name: zmk
    #   remote: narze
    #   revision: splitkb-aurora-lily58-with-double-encoders-infused-kim
    #   import: app/west.yml
  self:
    path: config
```
